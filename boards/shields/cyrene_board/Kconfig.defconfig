## boards/shields/cyrene_board/Kconfig.defconfig
```kconfig
if SHIELD_CYRENE_BOARD

# Name must be less than 16 characters long!
config ZMK_KEYBOARD_NAME
    default "Cyrene Board"

endif
```

## boards/shields/cyrene_board_hotswap/Kconfig.defconfig
```kconfig
if SHIELD_CYRENE_BOARD_HOTSWAP

# Name must be less than 16 characters long!
config ZMK_KEYBOARD_NAME
    default "Cyrene Board"

endif
```

## boards/shields/cyrene_board_hotswap/Kconfig.shield
```kconfig
config SHIELD_CYRENE_BOARD_HOTSWAP
    def_bool $(shields_list_contains,cyrene_board_hotswap)
```
